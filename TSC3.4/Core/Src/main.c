/* USER CODE BEGIN Header */
/**
  ******************************************************************************
  * @file           : main.c
  * @brief          : Main program body
  ******************************************************************************
  * @attention
  *
  * Copyright (c) 2025 STMicroelectronics.
  * All rights reserved.
  *
  * This software is licensed under terms that can be found in the LICENSE file
  * in the root directory of this software component.
  * If no LICENSE file comes with this software, it is provided AS-IS.
  *
  ******************************************************************************
  */
/* USER CODE END Header */
/* Includes ------------------------------------------------------------------*/
#include "main.h"
#include "touchsensing.h"

/* Private includes ----------------------------------------------------------*/
/* USER CODE BEGIN Includes */
#include <math.h>
#include "OLEDScreen.h"
#include <stdio.h>
/* USER CODE END Includes */

/* Private typedef -----------------------------------------------------------*/
/* USER CODE BEGIN PTD */
void I2C2WriteRegister(unsigned char Recv_addr, char Reg_addr, char Data);
void Clear_OLED(void);
void Set_Cursor_Pos(int , int );
void PrintChar_OLED(char );
void WriteString_OLED(char* );
void Draw_Point_OLED(int x, int y);
void Draw_Line_OLED (void);
void Draw_Rect_OLED (int w, int h);


/**************Defines Here for OLED, ssd1306************************/
#define OLED_addr          0x3C
//   *****   ssd Commands and data *************

#define SSD1306_LCDWIDTH      128
#define SSD1306_LCDHEIGHT      64
#define SSD1306_SETCONTRAST   0x81
#define SSD1306_DISPLAYALLON_RESUME 0xA4
#define SSD1306_DISPLAYALLON 0xA5
#define SSD1306_NORMALDISPLAY 0xA6
#define SSD1306_INVERTDISPLAY 0xA7
#define SSD1306_DISPLAYOFF 0xAE
#define SSD1306_DISPLAYON 0xAF
#define SSD1306_SETDISPLAYOFFSET 0xD3
#define SSD1306_SETCOMPINS 0xDA
#define SSD1306_SETVCOMDETECT 0xDB
#define SSD1306_SETDISPLAYCLOCKDIV 0xD5
#define SSD1306_SETPRECHARGE 0xD9
#define SSD1306_SETMULTIPLEX 0xA8
#define SSD1306_SETLOWCOLUMN 0x00
#define SSD1306_SETHIGHCOLUMN 0x10
#define SSD1306_SETSTARTLINE 0x40
#define SSD1306_MEMORYMODE 0x20
#define SSD1306_COLUMNADDR 0x21
#define SSD1306_PAGEADDR   0x22
#define SSD1306_COMSCANINC 0xC0
#define SSD1306_COMSCANDEC 0xC8
#define SSD1306_SEGREMAP 0xA0
#define SSD1306_CHARGEPUMP 0x8D
#define SSD1306_EXTERNALVCC 0x1
#define SSD1306_SWITCHCAPVCC 0x2
// Standard ASCII 5x7 font

/******* Prototype Function declarations ******/
void  ssd1306_command(unsigned char c);
////////////////////////////////////////////
void  ssd1306_data(unsigned char c);
///////////////////////////////////////////////////
// Used when doing Horizontal or Vertical Addressing
void setColAddress(int xCol);
/////////////////////////////////////////////////////
// Used when doing Horizontal or Vertical Addressing
void setPageAddress(int yPage);

void Init_OLED(int mode);

/* USER CODE END PTD */

/* Private define ------------------------------------------------------------*/
/* USER CODE BEGIN PD */

/* USER CODE END PD */

/* Private macro -------------------------------------------------------------*/
/* USER CODE BEGIN PM */

/* USER CODE END PM */

/* Private variables ---------------------------------------------------------*/
I2C_HandleTypeDef hi2c2;

TSC_HandleTypeDef htsc;

/* USER CODE BEGIN PV */
int x1;
float Distance1;
float Temp1;
float runsum1;
float Average1;
int nol = 10;
int Cycles1;

int x2;
float Distance2;
float Temp2;
float runsum2;
float Average2;
int Cycles2;

int x3;
float Distance3;
float Temp3;
float runsum3;
float Average3;
int Cycles3;

char buffer[20];
/* USER CODE END PV */

/* Private function prototypes -----------------------------------------------*/
void SystemClock_Config(void);
static void MX_GPIO_Init(void);
static void MX_TSC_Init(void);
static void MX_I2C2_Init(void);
/* USER CODE BEGIN PFP */

/* USER CODE END PFP */

/* Private user code ---------------------------------------------------------*/
/* USER CODE BEGIN 0 */

/* USER CODE END 0 */

/**
  * @brief  The application entry point.
  * @retval int
  */
int main(void)
{

  /* USER CODE BEGIN 1 */
	int i;
  /* USER CODE END 1 */

  /* MCU Configuration--------------------------------------------------------*/

  /* Reset of all peripherals, Initializes the Flash interface and the Systick. */
  HAL_Init();

  /* USER CODE BEGIN Init */

  /* USER CODE END Init */

  /* Configure the system clock */
  SystemClock_Config();

  /* USER CODE BEGIN SysInit */

  /* USER CODE END SysInit */

  /* Initialize all configured peripherals */
  MX_GPIO_Init();
  MX_TSC_Init();
  MX_TOUCHSENSING_Init();
  MX_I2C2_Init();
  /* USER CODE BEGIN 2 */
  tsl_user_Init();
  Init_OLED(0);
  Clear_OLED();

	WriteString_OLED("Measuring Tool");
	Set_Cursor_Pos(0, 0);
  /* USER CODE END 2 */

  /* Infinite loop */
  /* USER CODE BEGIN WHILE */
  while (1)
  {
	  runsum1 = 0;
	  runsum2 = 0;
	  runsum3 = 0;

	  for (i = 0; i < nol; i++) {
	  tsl_user_Exec();

	  x1 = MyTKeysB[0].p_ChD->Delta;
	  Cycles1 = MyTKeysB[0].p_ChD->Meas;
	  Distance1 = (3991.4 * pow(x1, -1.523));
	  Temp1 = ((int) (Distance1 * 100));
	  runsum1 = runsum1 + Distance1;
	  Average1 = runsum1 / nol;

	  x2 = MyTKeysB[1].p_ChD->Delta;
	  Cycles2 = MyTKeysB[1].p_ChD->Meas;
	  Distance2 = (2192.7 * pow(x2, -1.492));
	  Temp2 = ((int) (Distance2 * 100));
	  runsum2 = runsum2 + Distance2;
	  Average2 = runsum2 / nol;

	  x3 = MyTKeysB[2].p_ChD->Delta;
	  Cycles3 = MyTKeysB[2].p_ChD->Meas;
	  Distance3 = (571.9 * pow(x3, -1.423));
	  Temp3 = ((int) (Distance3 * 100));
	  runsum3 = runsum3 + Distance3;
	  Average3 = runsum3 / nol;
    /* USER CODE END WHILE */

    /* USER CODE BEGIN 3 */
  }
	  Set_Cursor_Pos(0, 3);
	  sprintf(buffer, "S1=%.3f", Average1);
	  WriteString_OLED(buffer);

	  Set_Cursor_Pos(0, 5);
	  sprintf(buffer, "S2=%.3f", Average2);
	  WriteString_OLED(buffer);

	  Set_Cursor_Pos(0, 7);
	  sprintf(buffer, "S3=%.3f", Average3);
	  WriteString_OLED(buffer);


  /* USER CODE END 3 */
}
}
/**
  * @brief System Clock Configuration
  * @retval None
  */
void SystemClock_Config(void)
{
  RCC_OscInitTypeDef RCC_OscInitStruct = {0};
  RCC_ClkInitTypeDef RCC_ClkInitStruct = {0};

  /** Initializes the RCC Oscillators according to the specified parameters
  * in the RCC_OscInitTypeDef structure.
  */
  RCC_OscInitStruct.OscillatorType = RCC_OSCILLATORTYPE_HSI;
  RCC_OscInitStruct.HSIState = RCC_HSI_ON;
  RCC_OscInitStruct.HSICalibrationValue = RCC_HSICALIBRATION_DEFAULT;
  RCC_OscInitStruct.PLL.PLLState = RCC_PLL_NONE;
  if (HAL_RCC_OscConfig(&RCC_OscInitStruct) != HAL_OK)
  {
    Error_Handler();
  }

  /** Initializes the CPU, AHB and APB buses clocks
  */
  RCC_ClkInitStruct.ClockType = RCC_CLOCKTYPE_HCLK|RCC_CLOCKTYPE_SYSCLK
                              |RCC_CLOCKTYPE_PCLK1;
  RCC_ClkInitStruct.SYSCLKSource = RCC_SYSCLKSOURCE_HSI;
  RCC_ClkInitStruct.AHBCLKDivider = RCC_SYSCLK_DIV1;
  RCC_ClkInitStruct.APB1CLKDivider = RCC_HCLK_DIV1;

  if (HAL_RCC_ClockConfig(&RCC_ClkInitStruct, FLASH_LATENCY_0) != HAL_OK)
  {
    Error_Handler();
  }
}

/**
  * @brief I2C2 Initialization Function
  * @param None
  * @retval None
  */
static void MX_I2C2_Init(void)
{

  /* USER CODE BEGIN I2C2_Init 0 */

  /* USER CODE END I2C2_Init 0 */

  /* USER CODE BEGIN I2C2_Init 1 */

  /* USER CODE END I2C2_Init 1 */
  hi2c2.Instance = I2C2;
  hi2c2.Init.Timing = 0x0000020B;
  hi2c2.Init.OwnAddress1 = 0;
  hi2c2.Init.AddressingMode = I2C_ADDRESSINGMODE_7BIT;
  hi2c2.Init.DualAddressMode = I2C_DUALADDRESS_DISABLE;
  hi2c2.Init.OwnAddress2 = 0;
  hi2c2.Init.OwnAddress2Masks = I2C_OA2_NOMASK;
  hi2c2.Init.GeneralCallMode = I2C_GENERALCALL_DISABLE;
  hi2c2.Init.NoStretchMode = I2C_NOSTRETCH_DISABLE;
  if (HAL_I2C_Init(&hi2c2) != HAL_OK)
  {
    Error_Handler();
  }

  /** Configure Analogue filter
  */
  if (HAL_I2CEx_ConfigAnalogFilter(&hi2c2, I2C_ANALOGFILTER_ENABLE) != HAL_OK)
  {
    Error_Handler();
  }

  /** Configure Digital filter
  */
  if (HAL_I2CEx_ConfigDigitalFilter(&hi2c2, 0) != HAL_OK)
  {
    Error_Handler();
  }
  /* USER CODE BEGIN I2C2_Init 2 */

  /* USER CODE END I2C2_Init 2 */

}

/**
  * @brief TSC Initialization Function
  * @param None
  * @retval None
  */
static void MX_TSC_Init(void)
{

  /* USER CODE BEGIN TSC_Init 0 */

  /* USER CODE END TSC_Init 0 */

  /* USER CODE BEGIN TSC_Init 1 */

  /* USER CODE END TSC_Init 1 */

  /** Configure the TSC peripheral
  */
  htsc.Instance = TSC;
  htsc.Init.CTPulseHighLength = TSC_CTPH_2CYCLES;
  htsc.Init.CTPulseLowLength = TSC_CTPL_2CYCLES;
  htsc.Init.SpreadSpectrum = DISABLE;
  htsc.Init.SpreadSpectrumDeviation = 1;
  htsc.Init.SpreadSpectrumPrescaler = TSC_SS_PRESC_DIV1;
  htsc.Init.PulseGeneratorPrescaler = TSC_PG_PRESC_DIV4;
  htsc.Init.MaxCountValue = TSC_MCV_8191;
  htsc.Init.IODefaultMode = TSC_IODEF_OUT_PP_LOW;
  htsc.Init.SynchroPinPolarity = TSC_SYNC_POLARITY_FALLING;
  htsc.Init.AcquisitionMode = TSC_ACQ_MODE_NORMAL;
  htsc.Init.MaxCountInterrupt = DISABLE;
  htsc.Init.ChannelIOs = TSC_GROUP1_IO2|TSC_GROUP2_IO4|TSC_GROUP5_IO2;
  htsc.Init.ShieldIOs = 0;
  htsc.Init.SamplingIOs = TSC_GROUP1_IO1|TSC_GROUP2_IO3|TSC_GROUP5_IO1;
  if (HAL_TSC_Init(&htsc) != HAL_OK)
  {
    Error_Handler();
  }
  /* USER CODE BEGIN TSC_Init 2 */

  /* USER CODE END TSC_Init 2 */

}

/**
  * @brief GPIO Initialization Function
  * @param None
  * @retval None
  */
static void MX_GPIO_Init(void)
{
  /* USER CODE BEGIN MX_GPIO_Init_1 */

  /* USER CODE END MX_GPIO_Init_1 */

  /* GPIO Ports Clock Enable */
  __HAL_RCC_GPIOA_CLK_ENABLE();
  __HAL_RCC_GPIOB_CLK_ENABLE();

  /* USER CODE BEGIN MX_GPIO_Init_2 */

  /* USER CODE END MX_GPIO_Init_2 */
}

/* USER CODE BEGIN 4 */
void I2C2WriteRegister(unsigned char Recv_addr, char Reg_addr, char Data) {
	//set up slave address (shifted 1 spot) and 2 byte transmission
	I2C2->CR2 = I2C_CR2_AUTOEND | (2 << 16) | Recv_addr << 1; //I2C_CR2_RD_WRN = 0 for write transfer; 7 bit address
	I2C2->CR2 |= I2C_CR2_START;   // start transfer

	while ((I2C2->ISR & I2C_ISR_TXIS) == 0)
		;
	I2C2->TXDR = Reg_addr;
	while ((I2C2->ISR & I2C_ISR_TXIS) == 0)
		;
	I2C2->TXDR = Data;
//	while ((I2C2->ISR &I2C_ISR_TC) ==0);

}
unsigned char asciiChar[]= {
	0x00, 0x00, 0x00, 0x00, 0x00,
	0x3E, 0x5B, 0x4F, 0x5B, 0x3E,
	0x3E, 0x6B, 0x4F, 0x6B, 0x3E,
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	0x00, 0x00, 0x00, 0x00, 0x00
};

void  ssd1306_command(unsigned char c)
{
	unsigned char control = 0x00; // some use 0X00 other examples use 0X80. I tried both
    //i2c_start();
    //i2c_write(_i2c_address);
    //i2c_write(control); // This is Command
    //i2c_write(c);
    //i2c_stop();
    //  All this should be in this function adapted here

    I2C2WriteRegister(OLED_addr, control, c);     // Writes 0x00 to data config register (0x0E).
    }
////////////////////////////////////////////
//
void  ssd1306_data(unsigned char c)
{
    //i2c_start();
    //i2c_write(_i2c_address);
    //i2c_write(0X40); // This byte is DATA
    //i2c_write(c);
    //i2c_stop();

    //  adapted for our iic functions...
    I2C2WriteRegister(OLED_addr, 0x40, c); // Writes 0x00 to data config register (0x0E).

}
///////////////////////////////////////////////////
// Used when doing Horizontal or Vertical Addressing
void setColAddress(int xCol)
{
	if(xCol>(SSD1306_LCDWIDTH-1))return;
  ssd1306_command(SSD1306_COLUMNADDR); // 0x21 COMMAND
  ssd1306_command(xCol); // Column start address
  ssd1306_command(SSD1306_LCDWIDTH-1); // Column end address  0 thru 127
}
/////////////////////////////////////////////////////
// Used when doing Horizontal or Vertical Addressing
void setPageAddress(int yPage)
{  if(yPage>(SSD1306_LCDHEIGHT/8-1))return;
  ssd1306_command(SSD1306_PAGEADDR); // 0x22 COMMAND
  ssd1306_command(yPage); // Start Page address
  ssd1306_command((SSD1306_LCDHEIGHT/8)-1);// End Page address 0-7   (0 thru(64/8)-1)
}
///////////////////////////////////////////////////////////
// Transfers the local buffer to the CGRAM in the SSD1306
void transferBuffer(int *p, int size,unsigned char xCol,unsigned char yPage)
{
	int j=0;
      // set the Column and Page addresses to 0,0
      setColAddress(xCol);
      setPageAddress(yPage);

      for(j=0;j<size;j++)
      {

        I2C2WriteRegister(OLED_addr, 0x40, *p); // Writes 0x00 to data config register (0x0E).
        p++;
      }

}

#define CHAR_MODE 0
#define GRAPHICS_Mode 1  //currently only char mode supported

void Init_OLED(int mode) //currently only char mode supported
{
	//Init_I2C2(400000);  //  PB13 (SCL) PB14 (SDA) are the OLED

    // Init sequence for 128x64 OLED module
	// init according to SSD1306 data sheet and many places on the web
    ssd1306_command(SSD1306_DISPLAYOFF);                    // 0xAE
    ssd1306_command(SSD1306_SETDISPLAYCLOCKDIV);            // 0xD5
    ssd1306_command(0x80);                 // the suggested ratio 0x80
    ssd1306_command(SSD1306_SETMULTIPLEX);                  // 0xA8
    ssd1306_command(0x3F);
    ssd1306_command(SSD1306_SETDISPLAYOFFSET);              // 0xD3
    ssd1306_command(0x0);                                   // no offset
    ssd1306_command(SSD1306_SETSTARTLINE);// | 0x0);        // line #0
    ssd1306_command(SSD1306_CHARGEPUMP);                    // 0x8D
    ssd1306_command(0x14);  // using internal VCC
    ssd1306_command(SSD1306_MEMORYMODE);                    // 0x20
    ssd1306_command(0x00);          // 0x00 horizontal addressing
    ssd1306_command(SSD1306_SEGREMAP | 0x1); // rotate screen 180
    ssd1306_command(SSD1306_COMSCANDEC); // rotate screen 180
    ssd1306_command(SSD1306_SETCOMPINS);                    // 0xDA
    ssd1306_command(0x12);
    ssd1306_command(SSD1306_SETCONTRAST);                   // 0x81
    ssd1306_command(0xCF);
    ssd1306_command(SSD1306_SETPRECHARGE);                  // 0xd9
    ssd1306_command(0xF1);
    ssd1306_command(SSD1306_SETVCOMDETECT);                 // 0xDB
    ssd1306_command(0x40);
    ssd1306_command(SSD1306_DISPLAYALLON_RESUME);           // 0xA4
    ssd1306_command(SSD1306_NORMALDISPLAY);                 // 0xA6
    ssd1306_command(SSD1306_DISPLAYON);                     //switch on OLED
}

void Clear_OLED(void)
{	int j=0;
      // set the Column and Page addresses to 0,0
      setColAddress(0);
      setPageAddress(0);

      for(j=0;j<1024;j++)
        I2C2WriteRegister(OLED_addr, 0x40, 0); // writing zeroes to every spot
}

void Set_Cursor_Pos(int pixel, int row){
	//across:  0<= pixel <=127.    down rows: 0<=  row  <=7
	//Set screen location from 0,0 upper right to 127,7 lower left
	      setColAddress(pixel);
	      setPageAddress(row);
	      }

void PrintChar_OLED(char ascii_x)

/*  This function will transfer the shape of each ascii character to the display.  Each character
 * is a matrix of points 5x7 dots,  The pattern for each character is given in the global array
 * asciiChar[].  Ex. the pattern for a '0' =ASCII 48 (0x30) is the 48th row of 5 values in the array
 *
 * 	0x3E, 0x51, 0x49, 0x45, 0x3E,  map these binary values vertically and you get an ASCII '0'
 *   -     x     x     x     -
 *   x     -     -     -     x
 *   x     x     -     -     x
 *   x     -     x     -     x
 *   x     -     -     x     x
 *   x     -     -     -     x
 *   -     x     x     x     -
 *     */
{
	int j,calc_Array_Index;
      calc_Array_Index= 5 * ascii_x; //find row in ascii array
      I2C2WriteRegister(OLED_addr, 0x40, 0); //some space before each character
      for(j=0;j<5;j++)
      {
        I2C2WriteRegister(OLED_addr, 0x40, asciiChar[calc_Array_Index]);
        calc_Array_Index++;
      }
      I2C2WriteRegister(OLED_addr, 0x40, 0); //some space after each character
}

void WriteString_OLED(char *str)
{	while (*str)
	{
	  PrintChar_OLED(*str);
	  str++;
	}
}
/* USER CODE END 4 */

/**
  * @brief  This function is executed in case of error occurrence.
  * @retval None
  */
void Error_Handler(void)
{
  /* USER CODE BEGIN Error_Handler_Debug */
  /* User can add his own implementation to report the HAL error return state */
  __disable_irq();
  while (1)
  {
  }
  /* USER CODE END Error_Handler_Debug */
}

#ifdef  USE_FULL_ASSERT
/**
  * @brief  Reports the name of the source file and the source line number
  *         where the assert_param error has occurred.
  * @param  file: pointer to the source file name
  * @param  line: assert_param error line source number
  * @retval None
  */
void assert_failed(uint8_t *file, uint32_t line)
{
  /* USER CODE BEGIN 6 */
  /* User can add his own implementation to report the file name and line number,
     ex: printf("Wrong parameters value: file %s on line %d\r\n", file, line) */
  /* USER CODE END 6 */
}
#endif /* USE_FULL_ASSERT */
