/*
 *	File:	OLEDScreen.h
 *	Author: James Eastman (adapted from St. Denis)
 */

#include "OLEDScreen.h"

I2C_HandleTypeDef hi2c;
uint16_t address;
uint32_t timeout;

// Global Variables
static uint8_t asciiChar[256][5] = {
	{0x00, 0x00, 0x00, 0x00, 0x00},	//	NUL
	{0x3E, 0x5B, 0x4F, 0x5B, 0x3E},	//	SOH
	{0x3E, 0x6B, 0x4F, 0x6B, 0x3E},	//
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	{0x00, 0x00, 0x00, 0x00, 0x00}
};

int colCount = 0;
int pageCount = 0;

void OLED_I2C_Init(I2C_HandleTypeDef hi2c_input, uint16_t address_input){
	// setup
	hi2c = hi2c_input;
	address = address_input << 1;
	timeout = 1000;
	// Delay to let OLED boot
	HAL_Delay(100);


	OLED_sendCommand(DISPLAY_OFF);

	OLED_sendCommand(CLOCK_DIVIDE);
	OLED_sendCommand(0x80);	// Value

	OLED_sendCommand(MULTIPLEX_RATIO);
	OLED_sendCommand(0x3F);	// Value

	OLED_sendCommand(DISPLAY_OFFSET);
	OLED_sendCommand(0x00);	// Value

	OLED_sendCommand(SET_START_LINE);

	OLED_sendCommand(CHARGE_PUMP);	// Set Charge Pump
	OLED_sendCommand(0x14);	// Value

	OLED_sendCommand(MEMORY_MODE);
	OLED_sendCommand(0x00);	// Value

	OLED_sendCommand(SEG_REMAP | 0x01);	// Rotate screen 180

	OLED_sendCommand(COM_SCAN_REMAPPED);	// Rotate screen 180

	OLED_sendCommand(SET_CONTRASTAT);
	OLED_sendCommand(0x66);	// Value

	OLED_sendCommand(PRECHARGE_PERIOD);
	OLED_sendCommand(0xF1);	// Value

	OLED_sendCommand(VCOMH_DESELECT);
	OLED_sendCommand(0x40);	// Value

	OLED_sendCommand(SET_COM_PINS);
	OLED_sendCommand(0x12);	// Value

	OLED_sendCommand(VCOMH_DESELECT);
	OLED_sendCommand(0x30);	// Value

	OLED_sendCommand(RAM_CONTENT_ON);
	OLED_sendCommand(NORMAL_DISPLAY);

	OLED_sendCommand(DISPLAY_ON);
	HAL_Delay(100);

	OLED_clearScreen();

}
// Sends commands for changing settings.
void OLED_sendCommand(uint8_t data){
	uint8_t control = 0x00; // Value for command
	uint8_t pData[2];		// The actual data to send
	pData[0] = control;		// We first send the control byte tell the SSD1306 that the next byte is a command
	pData[1] = data;		// Now we set the data
	HAL_StatusTypeDef error;
	// Transmit data
	error = HAL_I2C_Master_Transmit(&hi2c, address, pData, 2, timeout);
	// If There's an error, send hard fault
	if(error == HAL_ERROR){
		return;
	}
}
// Sends data to the screen
void OLED_sendData(uint8_t data){
	uint8_t control = 0x40;
	uint8_t pData[2];
	pData[0] = control;
	pData[1] = data;
	HAL_I2C_Master_Transmit(&hi2c, address, pData, 2, timeout);
	colCount++;
}
// Set the column address pointer in the SSD1306
void OLED_setColAddress(uint16_t xCol){
	if(xCol>(OLED_WIDTH-1))return;
	OLED_sendCommand(COLUMN_ADDRESS);
	OLED_sendCommand(xCol);
	OLED_sendCommand(OLED_WIDTH - 1);
	colCount = xCol;
}
// Set the page address in the SSD1306
void OLED_setPageAddress(uint16_t yPage){
	if(yPage > (OLED_HEIGHT/8-1))return;
	OLED_sendCommand(PAGE_ADDRESS);
	OLED_sendCommand(yPage);
	OLED_sendCommand(OLED_HEIGHT/8-1);
	pageCount = yPage;
}
// Set the location of the cursor by setting both the column and the page address
void OLED_setLocation(uint16_t xCol, uint16_t yPage){
	OLED_setColAddress(xCol);
	OLED_setPageAddress(yPage);
}
// Print a single charter to the screen
void OLED_printChar(char character){
	uint8_t column;

	OLED_sendData(0);
	for(column = 0; column < 5; column++){
		OLED_sendData(asciiChar[(unsigned char)character][column]);
	}
	OLED_sendData(0);
}
// Write an entire string to the screen.
void OLED_writeString(char *c){
	while(*c){
		OLED_printChar(*c);
		c++;
	}
}
// Clears the entire screen
void OLED_clearScreen(void){
	OLED_setLocation(0,0);
	for(int j=0; j<=7; j++){
		OLED_setLocation(0, j);
		for(int i=0; i < OLED_WIDTH; i++){
			OLED_sendData(0x00);
		}
	}

}
// Clears single line from screen
void OLED_clearLine(int x){
	OLED_setLocation(0,x);
	for(int i=0; i < OLED_WIDTH; i++){
		OLED_sendData(0x00);
	}
}
// Clears the number of characters specified
void OLED_clearChar(int x){
	for(int i = colCount; i>x; i--){
		OLED_setLocation(i, pageCount);
		OLED_sendData(0x00);
	}
}
